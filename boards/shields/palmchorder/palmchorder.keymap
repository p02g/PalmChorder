// This file was generated from a template. Edit it to match your keyboard.
// See https://zmk.dev/docs/development/hardware-integration/new-shield for more instructions.

#include <behaviors.dtsi>
#include <dt-bindings/zmk/keys.h>

/ {
    // Define a default keymap here.
    // See https://zmk.dev/docs/development/hardware-integration/new-shield#default-keymap.
    keymap {
        compatible = "zmk,keymap";

        default_layer {
            //      0     1     2     3     4     5     6     7     8
            bindings = <
                &kp A &kp B &kp C &kp D &kp E &kp S &kp A &kp W &kp D &studio_unlock
            >;
        };

    };
};
